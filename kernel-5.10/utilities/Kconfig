## kernel-5.10/utilities/Kconfig
```kconfig
menu "Utilities"

source "utilities/Kconfig.docker"
source "utilities/Kconfig.ubuntu_chroot"
source "utilities/Kconfig.lxc"

endmenu
```

## kernel-5.10/utilities/Kconfig.docker
```kconfig
menu "Docker support"

# Generally Necessary
config DOCKER
	bool "Core Docker support (Generally Necessary)"
	default y
	help
		Enable generally necessary options required for Docker.
		This includes namespaces, cgroups, and basic networking.

	# Namespaces
	select NAMESPACES
	select NET_NS
	select PID_NS
	select IPC_NS
	select UTS_NS

	# Control Groups
	select CGROUPS
	select CGROUP_CPUACCT
	select CGROUP_DEVICE
	select CGROUP_FREEZER
	select CGROUP_SCHED
	select CPUSETS
	select MEMCG

	# Keys
	select KEYS

	# Basic Networking
	select VETH
	select BRIDGE
	select BRIDGE_NETFILTER

	# Netfilter - IPv4
	select IP_NF_FILTER
	select IP_NF_MANGLE
	select IP_NF_TARGET_MASQUERADE
	select IP_NF_RAW
	select IP_NF_NAT

	# Netfilter - IPv6
	select IP6_NF_FILTER
	select IP6_NF_MANGLE
	select IP6_NF_TARGET_MASQUERADE
	select IP6_NF_RAW
	select IP6_NF_NAT

	# Netfilter - Core
	select NF_NAT
	select NF_NAT_IPV4
	select NF_NAT_NEEDED
	select NETFILTER_XT_MATCH_ADDRTYPE
	select NETFILTER_XT_MATCH_CONNTRACK
	select NETFILTER_XT_MATCH_IPVS
	select NETFILTER_XT_MARK

	# POSIX Message Queues
	select POSIX_MQUEUE

# Optional Features
config DOCKER_OPTIONAL
	bool "Optional Docker features"
	default y if DOCKER
	depends on DOCKER
	help
		Enable optional Docker features for enhanced functionality.

	# User Namespaces
	select USER_NS

	# Security
	select SECCOMP
	select SECCOMP_FILTER

	# Additional Cgroups
	select CGROUP_PIDS
	select MEMCG_SWAP
	select MEMCG_SWAP_ENABLED
    select HUGETLBFS
	select HUGETLB_PAGE
	select CGROUP_HUGETLB
	select NET_CLS_CGROUP
	select CGROUP_NET_PRIO
	select CGROUP_PERF

	# Block I/O
	select IOSCHED_CFQ
	select CFQ_GROUP_IOSCHED
	select BLK_CGROUP
	select BLK_DEV_THROTTLING

	# CPU Scheduling
	select CFS_BANDWIDTH
	select FAIR_GROUP_SCHED

	# Network Features
	select IP_NF_TARGET_REDIRECT
	select IP_SCTP
	select IP_VS
	select IP_VS_NFCT
	select IP_VS_PROTO_TCP
	select IP_VS_PROTO_UDP
	select IP_VS_RR

	# Security Modules
	select SECURITY_APPARMOR

	# nftables
	select NF_TABLES
	select NF_TABLES_IPV4
	select NF_TABLES_IPV6
	select NFT_CT
	select NFT_FIB_IPV4
	select NFT_FIB_IPV6
	select NFT_FIB
	select NFT_MASQ
	select NFT_NAT

	# Filesystems
	select EXT3_FS
	select EXT3_FS_XATTR
	select EXT3_FS_POSIX_ACL
	select EXT3_FS_SECURITY
	select EXT4_FS
	select EXT4_FS_POSIX_ACL
	select EXT4_FS_SECURITY

# Network Drivers
config DOCKER_NETWORK_DRIVERS
	bool "Network drivers"
	default y if DOCKER
	depends on DOCKER
	help
		Enable all Docker network drivers (Bridge, Overlay, IPvlan, Macvlan, FTP/TFTP).

	# Overlay network driver
	select VXLAN
	select BRIDGE_VLAN_FILTERING

	# Encrypted overlay networks (optional)
	select CRYPTO
	select CRYPTO_AEAD
	select CRYPTO_GCM
	select CRYPTO_SEQIV
	select CRYPTO_GHASH
	select XFRM
	select XFRM_USER
	select XFRM_ALGO
	select INET_ESP
	select NETFILTER_XT_MATCH_BPF
	select INET_XFRM_MODE_TRANSPORT

	# IPvlan network driver
	select IPVLAN

	# Macvlan network driver
	select MACVLAN
	select DUMMY

	# FTP/TFTP client in container
	select NF_NAT_FTP
	select NF_CONNTRACK_FTP
	select NF_NAT_TFTP
	select NF_CONNTRACK_TFTP

# Storage Drivers
config DOCKER_STORAGE_DRIVERS
	bool "Storage drivers"
	default y if DOCKER
	depends on DOCKER
	help
		Enable all Docker storage drivers (Btrfs, Overlay, Device Mapper, AUFS).

	# Btrfs storage driver
	select BTRFS_FS
	select BTRFS_FS_POSIX_ACL

	# Overlay storage driver
	select OVERLAY_FS
	select EXT4_FS_SECURITY
	select EXT4_FS_POSIX_ACL

	# Device Mapper storage driver
	select BLK_DEV_DM
	select DM_THIN_PROVISIONING
	select EXT4_FS
	select EXT4_FS_POSIX_ACL
	select EXT4_FS_SECURITY

	# AUFS storage driver
	select AUFS_FS
	select EXT4_FS_POSIX_ACL
	select EXT4_FS_SECURITY

endmenu
```

## kernel-5.10/utilities/Kconfig.lxc
```kconfig
menu "LXC support"

config LXC
	bool "LXC support"
	default y
	help
		Enable options required for Linux Containers (LXC).
		
		This includes essential kernel configurations for:
		- Core namespace support (isolation)
		- Control groups (cgroups)
		- Network virtualization
		- Checkpoint/Restore functionality
		- FUSE support (for lxcfs)
		
		For more information, see:
		https://linuxcontainers.org/lxc/

	# Namespaces (required)
	select NAMESPACES
	select UTS_NS
	select IPC_NS
	select PID_NS
	select USER_NS
	select NET_NS

	# Control groups (required)
	select CGROUPS
	select CGROUP_DEVICE
	select CGROUP_SCHED
	select CGROUP_CPUACCT
	select MEMCG
	select CPUSETS

	# Network virtualization
	select VETH
	select MACVLAN
	select VLAN_8021Q
	select BRIDGE

	# Netfilter (for NAT and masquerading)
	select NETFILTER_ADVANCED
	select NF_NAT_IPV4
	select NF_NAT_IPV6
	select IP_NF_TARGET_MASQUERADE
	select IP6_NF_TARGET_MASQUERADE
	select NETFILTER_XT_TARGET_CHECKSUM
	select NETFILTER_XT_MATCH_COMMENT

	# FUSE (for use with lxcfs)
	select FUSE_FS

	# Checkpoint/Restore
	select CHECKPOINT_RESTORE
	select FHANDLE
	select EVENTFD
	select EPOLL
	select UNIX_DIAG
	select INET_DIAG
	select PACKET_DIAG
	select NETLINK_DIAG

endmenu
```

## kernel-5.10/utilities/Kconfig.ubuntu_chroot
```kconfig
menu "Ubuntu Chroot support"

config UBUNTU_CHROOT
	bool "Ubuntu Chroot support"
	default y
	help
		Enable options required for running Ubuntu 24.04 in chroot
		on Android with full hardware access and namespace isolation.
		
		This includes essential kernel configurations for:
		- Core namespace support (isolation)
		- Essential filesystems
		- QEMU support for x86_64 binaries
		- Terminal support
		- Basic networking
		- IPC mechanisms
		- Control groups (for Docker)
		- Event handling and file monitoring
		- Security features
		- Advanced features (OverlayFS, FUSE, etc.)
		
		For more information, see:
		https://github.com/ravindu644/Ubuntu-Chroot?tab=readme-ov-file#kernel-requirements

	# Essential for basic chroot functionality
	# Core namespace support (required for isolation)
	select NAMESPACES
	select PID_NS
	select UTS_NS
	select IPC_NS

	# Essential filesystems
	select PROC_FS
	select SYSFS
	select DEVTMPFS
	select TMPFS
	select EXT4_FS

	# QEMU support
	select BINFMT_MISC
	select BINFMT_SCRIPT
	select BINFMT_ELF

	# Terminal support
	select UNIX98_PTYS
	select TTY
	select DEVPTS_FS

	# Basic networking
	select NET
	select INET
	select UNIX

	# Threading support
	select FUTEX

	# File operations
	select FILE_LOCKING

	# Common functionality requirements
	# IPC mechanisms (required by many apps and daemons)
	# KDiskMark and Brave Browser will fail without these
	select SYSVIPC
	select POSIX_MQUEUE

	# Device management
	select DEVTMPFS_MOUNT

	# Extended filesystem features
	select TMPFS_POSIX_ACL
	select TMPFS_XATTR
	select EXT4_FS_POSIX_ACL
	select EXT4_FS_SECURITY

	# Control groups (essential for Docker)
	select CGROUPS
	select CGROUP_DEVICE
	select MEMCG

	# Event handling
	select EPOLL
	select EVENTFD
	select SIGNALFD
	select TIMERFD

	# File monitoring
	select INOTIFY_USER

	# Security
	select SECCOMP
	select SECCOMP_FILTER

	# Networking features
	select IPV6
	select PACKET

	# Legacy PTY
	select LEGACY_PTYS

	# OPTIONAL: Advanced features and specific use cases
	# Advanced cgroup controllers
	select CGROUP_CPUACCT
	select CGROUP_SCHED
	select CGROUP_FREEZER
	select CGROUP_PIDS
	select MEMCG_SWAP

	# Overlay filesystem
	select OVERLAY_FS

	# FUSE
	select FUSE_FS

	# Firmware loading
	select FW_LOADER
	select FW_LOADER_USER_HELPER
	select FW_LOADER_COMPRESS

	# Loop devices
	select BLK_DEV_LOOP

	# Async I/O
	select AIO

	# System control interface
	select PROC_SYSCTL
	select SYSVIPC_SYSCTL

endmenu
```
